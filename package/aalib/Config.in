## package/aalib/Config.in
```kconfig
config BR2_PACKAGE_AALIB
	bool "AAlib"
	help
	  AAlib is an portable ascii art GFX library.

	  http://aa-project.sourceforge.net/aalib/
```

## package/mdp/Config.in
```kconfig
config BR2_PACKAGE_MDP
	bool "MDP"
	help
	  A command-line based markdown presentation tool

	  https://github.com/visit1985/mdp
```
